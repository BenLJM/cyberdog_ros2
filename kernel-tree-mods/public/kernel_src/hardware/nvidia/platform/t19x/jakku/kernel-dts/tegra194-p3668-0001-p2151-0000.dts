/*
 * Top level DTS file for CVM:P3668-0001 and CVB:P3509-0000.
 *
 * Copyright (c) 2019-2020, NVIDIA CORPORATION.  All rights reserved.
 *
 * This program is free software; you can redistribute it and/or modify
 * it under the terms of the GNU General Public License as published by
 * the Free Software Foundation; version 2 of the License.
 *
 * This program is distributed in the hope that it will be useful, but WITHOUT
 * ANY WARRANTY; without even the implied warranty of MERCHANTABILITY or
 * FITNESS FOR A PARTICULAR PURPOSE.  See the GNU General Public License for
 * more details.
 */

/dts-v1/;
#include "common/tegra194-p3668-common.dtsi"
#include "common/tegra194-p2151-0000.dtsi"

/ {
	nvidia,dtsfilename = "p3668-0001-p2151-0000.dts";
	nvidia,dtbbuildtime = __DATE__, __TIME__;

	model = "Xiaomi Cyberdog";
	compatible = "nvidia,p2151-0000+p3668-0001", "nvidia,tegra194";
};

/* CyberDog mi-k91 audio card (rt5680 6-mic + tas5805m amp, tegra-alt t186ref) */
#include "tegra194-mi-k91-audio.dtsi"

/* CyberDog mi-k91 platform fixups for the r32-cboot + r35-kernel hybrid boot:
 * thermal-zones map3 deletion (the thermtrip power-off guard), adsp_audio
 * disable, clocks-init aonclk trim.  Split out of tegra194-mi-k91-audio.dtsi
 * on 2026-07-26 (task F3) so that reverting/replacing the audio DTS can no
 * longer silently reintroduce the thermal shutdown.
 * MUST stay immediately after the audio include -- that is exactly where
 * these blocks used to sit, and keeping the position keeps the built DTB
 * bit-identical to the pre-split one. */
#include "tegra194-mi-k91-fixups.dtsi"

/* RCE camera RTCPU: force legacy shared-mailbox (SM5) HSP so the R35 kernel can
 * talk to the factory R32-era RCE firmware in QSPI. Pairs with the command-layer
 * driver patch. MUST be after tegra194-camera.dtsi (SoC) is included. */
#include "tegra194-mi-k91-rtcpu-legacy.dtsi"

